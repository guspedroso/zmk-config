## config/west.yml
```yaml
manifest:
  remotes:
    - name: guspedroso
      url-base: https://github.com/guspedroso
  projects:
    - name: zmk
      remote: guspedroso
      revision: main
      import: app/west.yml
  self:
    path: config
```
