#include <dt-bindings/zmk/matrix_transform.h>
#include "microdox_base.dtsi"

&microdox_layout {
    transform = <&default_transform>;
};

/ {
    chosen {
        zmk,kscan = &kscan0;
    };

    default_transform: microdox_transform {
        compatible = "zmk,physical-layout-transform-grid";

        rows = <4>;
        columns = <10>;

        key-size-mm = <18>;
        key-spacing-mm = <19>;

        row-offsets-mm = <
            0   /* row 0 */
            0   /* row 1 */
            0   /* row 2 */
            0   /* row 3 */
        >;

        column-offsets-mm = <
            0 0 0 0 0 0 0 0 0 0
        >;
    };
};
